## drivers/oneplus/Kconfig
```kconfig
config OEM_BOOT_MODE
	bool "detect oem boot mode"
	default y
	help
          detect oem boot mode  If unsure, say y.

config HOUSTON_DUMMY
	bool "dummy interfaces for houston"
	default y
	help
	  dummy interfaces for houston if used on OOS.
```
